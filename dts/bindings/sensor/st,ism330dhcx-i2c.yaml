## dts/bindings/sensor/st,ism330dhcx-i2c.yaml
```yaml
# Copyright (c) 2020 STMicroelectronics
# SPDX-License-Identifier: Apache-2.0

asdfasdasf
asdf
description: |
    STMicroelectronics ISM330DHCX 6-axis IMU (Inertial Measurement Unit) sensor
    accessed through I2C bus

compatible: "st,ism330dhcx"

include: ["i2c-device.yaml", "st,ism330dhcx-common.yaml"]
```
